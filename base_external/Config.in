## base_external/Config.in
```kconfig
menu "AESD Assignments"

source "$BR2_EXTERNAL_project_base_PATH/package/aesd-assignments/Config.in"

endmenu
```

## base_external/package/aesd-assignments/Config.in
```kconfig
config BR2_PACKAGE_AESD_ASSIGNMENTS
	bool "aesd-assignments"
	help
	  Includes the writer executable, finder scripts, and aesdsocket from the assignments repository.
```

## base_external/package/ldd/Config.in
```kconfig
config BR2_PACKAGE_LDD
        bool "ldd"
        help
          Out-of-tree Linux Device Drivers from the ldd3 repository fork.
          Builds and installs:
            - misc-modules (hello + faulty)
            - scull
```
